## config/boards/shields/keyball_nano/Kconfig.defconfig
```kconfig
if SHIELD_KEYBALL39_CENTRAL_DONGLE || SHIELD_KEYBALL39_CENTRAL_DONGLE_NOSCREEN

config ZMK_KEYBOARD_NAME
	default "Keyball39-Dong"

config ZMK_SPLIT_ROLE_CENTRAL
	default y

endif

if SHIELD_KEYBALL39_CENTRAL_DONGLE || SHIELD_KEYBALL39_CENTRAL_DONGLE_NOSCREEN || SHIELD_KEYBALL39_LEFT || SHIELD_KEYBALL39_RIGHT

config ZMK_SPLIT
	default y
	
endif

if SHIELD_KEYBALL39_ESB_NICE_VIEW

config LS0XX_VCOM_THREAD_PRIO
    default 11

config LV_Z_VDB_SIZE
    default 100

config LV_DPI_DEF
    default 161

config LV_Z_BITS_PER_PIXEL
    default 1

choice LV_COLOR_DEPTH
    default LV_COLOR_DEPTH_1
endchoice

choice ZMK_DISPLAY_WORK_QUEUE
    default ZMK_DISPLAY_WORK_QUEUE_DEDICATED
endchoice

choice ZMK_DISPLAY_STATUS_SCREEN
    default ZMK_DISPLAY_STATUS_SCREEN_BUILT_IN
endchoice

config LV_Z_MEM_POOL_SIZE
    default 5120

config ZMK_WIDGET_BATTERY_STATUS_SHOW_PERCENTAGE
    default y

endif

if ZMK_DISPLAY

config I2C
    default y

config SSD1306
    default y

choice ZMK_DISPLAY_WORK_QUEUE
    default ZMK_DISPLAY_WORK_QUEUE_DEDICATED
endchoice

endif

if LVGL

config LV_Z_VDB_SIZE
    default 64

config LV_DPI_DEF
    default 148

config LV_Z_BITS_PER_PIXEL
    default 1

choice LV_COLOR_DEPTH
    default LV_COLOR_DEPTH_1
endchoice

endif 
```

## config/boards/shields/keyball_nano/Kconfig.shield
```kconfig
config SHIELD_KEYBALL39_CENTRAL_DONGLE
    def_bool $(shields_list_contains,keyball39_central_dongle)

config SHIELD_KEYBALL39_CENTRAL_DONGLE_NOSCREEN
    def_bool $(shields_list_contains,keyball39_central_dongle_noscreen)

config SHIELD_KEYBALL39_LEFT
    def_bool $(shields_list_contains,keyball39_left)

config SHIELD_KEYBALL39_RIGHT
    def_bool $(shields_list_contains,keyball39_right)

config SHIELD_KEYBALL39_ESB_NICE_VIEW
    def_bool $(shields_list_contains,keyball39_esb_nice_view)
```

## dts/bindings/keyball,input-processor-trackball-arrows.yaml
```yaml
description: Convert relative trackball movement into directional behavior taps.

compatible: "keyball,input-processor-trackball-arrows"

include: base.yaml

properties:
  tick:
    type: int
    required: true
  tap-ms:
    type: int
    default: 0
  wait-ms:
    type: int
    default: 0
  bindings:
    type: phandle-array
    required: true
  track-remainders:
    type: boolean

input-processor-cells: []
```
