## Kconfig
```kconfig
config ZMK_SPLIT_BLE_ANY_CENTRAL
    bool "Split peripheral connects to any bonded central (multiple dongles)"
    depends on ZMK_SPLIT_BLE && !ZMK_SPLIT_ROLE_CENTRAL
    help
      Replace the stock BLE split peripheral advertising policy. Instead of
      advertising directed at the one central it bonded with first, the
      peripheral always advertises undirected, so any dongle it has bonded with
      (or a new, unpaired dongle) connects to it. Set BT_MAX_PAIRED to the
      number of dongles you want to keep paired.

if ZMK_SPLIT_BLE_ANY_CENTRAL

config ZMK_SPLIT_BLE_ANY_CENTRAL_PRIORITY
    int "Split transport priority"
    default 0
    help
      Must sort before CONFIG_ZMK_SPLIT_BLE_PRIORITY so this transport is
      selected instead of the stock BLE peripheral transport.

config ZMK_SPLIT_BLE_ANY_CENTRAL_FAST_ADV_S
    int "Seconds of fast advertising before falling back to slow advertising"
    default 30

endif
```
